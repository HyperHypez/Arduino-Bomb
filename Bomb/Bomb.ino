// Group 66
// Harrison Vu, hvu28, hvu28
// Anusha Muthekepalli, anusharm
// Daniel Kim, dkim344, dkim344
// Chris Szeliga, cszel3, cszel3
// Bomb defusal game
/* In this bomb defusal game, there exists a microcontroller “bomb” that must collectively be defused by 3 other microcontrollers that act as defusers. The mission is for a team of three players to attempt to unscramble their own scrambled word displayed on their microcontroller’s LCD screen, and if successful, the bomb will be defused. Otherwise, if the players are unsuccessful in unscrambling their words by the time the bomb timer expires, the bomb explodes and they lose the game. */

#include "SevSeg.h"
#include <PCM.h>
#include <Wire.h>

// Array of audio samples for bomb explosion sound effect
const unsigned char explosion[] PROGMEM = {
  125, 125, 126, 126, 126, 126, 126, 126, 126, 126, 126, 126,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 151
};

// Create SevSeg object for 7 segment 4 digit display
SevSeg sevseg;
// Number of digits in display
byte numDigits = 4;
// Display select pins
byte digitPins[] = {10, A0, 12, 13}; // INDEX 1 IS ORIGINALLY 11 column 9 with the resistors for segment display!!!!
// Display segment pins A,B,C,D,E,F,G,DP
byte segmentPins[] = {9, 2, 3, 5, 6, 8, 7, 4};
// Dropping resistors used
bool resistorsOnSegments = true;
// Display type
byte hardwareConfig = COMMON_CATHODE;

// Set pin numbers for I/O devices
const int buttonPin = A3;  // start button pin
const int gLEDPin = A2;    // green LED pin
const int rLEDPin = A1;  // red LED pin
const int buzzerPin = 1; // passive buzzer pin
const int transistorPin = 11; // transistor/speaker pin ORIGINALLY A0!!!!

// Variable to carry the state of the pushbutton
int buttonState;

// Declare time variables
unsigned long timerDuration = 120000; // bomb timer is 2 minutes
unsigned long startTime = 0; // time when the game is started by pressing the pushbutton

// Flag to indicate whether bomb is active or not
bool bombActive = false;  // whether the bomb is active or not

// Counter to check how many defusers have successfully unscrambled their word
int successfulDefuses = 0;

// Function for receiving data from defusers via I2C
void receiveData(int byteCount) {
  while (Wire.available()) {
    int receivedData = Wire.read();
    successfulDefuses += receivedData;
  }
}

void setup() {
  // Set up I2C Communication
  Wire.begin(9);
  Wire.onReceive(receiveData);
  
  // Set up LEDS
  pinMode(rLEDPin, OUTPUT);
  pinMode(gLEDPin, OUTPUT);

  pinMode(A4, INPUT_PULLUP); // Enable internal pull-up resistor for SDA
  pinMode(A5, INPUT_PULLUP); // Enable internal pull-up resistor for SCL

  // Pushbutton and buzzer
  pinMode(buttonPin, INPUT);
  pinMode(buzzerPin, OUTPUT);
  pinMode(transistorPin, OUTPUT);
  buttonState = 0;

  // Start 7-segment display object
  sevseg.begin(hardwareConfig, numDigits, digitPins, segmentPins, resistorsOnSegments);
  // Set brightness
  sevseg.setBrightness(90);
}

void loop() {
  // Read the state of the pushbutton value
  buttonState = digitalRead(buttonPin);

  // Check if the pushbutton is pressed and make sure bomb is not already active.
  if (buttonState == HIGH && !bombActive) {
    bombActive = true; // start the bomb
    startTime = millis(); // log when the game is started
  }

  // Bomb is active and counting down
  if (bombActive) {
    if (timerDuration + startTime < millis()) { // if bomb timer runs out
      bombActive = false; // set bomb to no longer be active
      digitalWrite(rLEDPin, HIGH); // turn on red LED
      sevseg.setNumber(0); // set bomb timer to statically show 0
      startPlayback(explosion, sizeof(explosion)); // play bomb explosion on speakers
      delay(5000); // wait for explosion sound effect to finish
      tone(buzzerPin, 1000); // play passive buzzer tone
      //noTone(buzzerPin); // stop passive buzzer tone
    }
    else if (successfulDefuses == 3) { // if all defusers successfully unscramble their words, the bomb is defused
      bombActive = false; // set bomb to no longer be active
      sevseg.setNumber((timerDuration + startTime - millis()) / 100, 1); // set bomb timer to stay static and stop counting down when bomb defused
      digitalWrite(gLEDPin, HIGH); // turn on green LED
      digitalWrite(rLEDPin, LOW); // turn off red LED if it is on
    }
    else { // bomb is neither exploded or defused
      // Have red LED flash while bomb is active
      if ((millis()/1000) % 2 == 0) { // when the seconds is divisible by 2
        digitalWrite(rLEDPin, HIGH); // turn red LED on
      }
      else {
        digitalWrite(rLEDPin, LOW); // turn red LED off
      }

      // Update bomb timer
      sevseg.setNumber((timerDuration + startTime - millis()) / 100, 1);
    }
  }

  // Refresh bomb timer
  sevseg.refreshDisplay(); // Must run repeatedly
  delay(2); // delay to give display smoothness
}